## boards/tsi/skyp/tsi_skyp_txe_defconfig
```kconfig
# SPDX-License-Identifier: Apache-2.0

# # size of stack for initialization and main thread
# CONFIG_MAIN_STACK_SIZE=3072

# # enable logger
# CONFIG_LOG=y

# # no need for a "raw" binary zephyr/zephyr.bin in the build directory
CONFIG_BUILD_OUTPUT_BIN=n
# CONFIG_BUILD_OUTPUT_HEX=y

# # enable uart driver
# CONFIG_SERIAL=y

# # clock configuration
# CONFIG_CLOCK_CONTROL=y

# # console (remote proc console by default)
# CONFIG_CONSOLE=y

# # uart console (overrides remote proc console)
# CONFIG_UART_CONSOLE=y

# # enable pin controller
# CONFIG_PINCTRL=y

# size of stack for initialization and main thread
CONFIG_MAIN_STACK_SIZE=2048

CONFIG_GEN_ISR_TABLES=n
CONFIG_GEN_IRQ_VECTOR_TABLE=n
CONFIG_SIMULATOR_XTENSA=y
```

## boards/tsi/tsi/board.yml
```yaml
board:
  name: tsi
  vendor: Tsavorite
  socs:
  - name: skyp
    variants:
    - name: tensilica
      cpucluster: txe
    - name: cortex-m85
      cpucluster: m85
```

## soc/tsi/Kconfig
```kconfig
# Copyright (c) 2024 TSI
# SPDX-License-Identifier: Apache-2.0

if SOC_FAMILY_ARM || SOC_FAMILY_ARM64

rsource "*/Kconfig"

config BUILD_WITH_TFM
	default y if TRUSTED_EXECUTION_NONSECURE
	help
	  By default, if we build for a Non-Secure version of the board,
	  enable building with TF-M as the Secure Execution Environment.

endif # SOC_FAMILY_ARM || SOC_FAMILY_ARM64
```

## soc/tsi/skyp_v1/Kconfig
```kconfig
# Copyright (c) 2024 Renesas Electronics Corporation
# SPDX-License-Identifier: Apache-2.0

#config SOC_SERIES_SKYP_V1
config SOC_SKYP_M85
	select ARM

#config SOC_SERIES_SKYP_V1
config SOC_SKYP_M85
	select CPU_CORTEX_M85
	select CPU_HAS_ARM_SAU
	select CPU_HAS_ARM_MPU
	select CPU_HAS_FPU
	select ARMV8_M_DSP
	select ARMV8_1_M_MVEI
	select ARMV8_1_M_MVEF
	select ARMV8_1_M_PMU

config ARMV8_1_M_PMU_EVENTCNT
	int
	default 8 if SOC_SERIES_SKYP_V1


#  config  SOC_SKYP_TXE 
#     select XTENSA
# 	select XTENSA_HAL if ("$(ZEPHYR_TOOLCHAIN_VARIANT)" != "xcc" && "$(ZEPHYR_TOOLCHAIN_VARIANT)" != "xt-clang")
# 	select XTENSA_RESET_VECTOR
# 	select XTENSA_USE_CORE_CRT1
# 	select ATOMIC_OPERATIONS_BUILTIN
# 	select GEN_ISR_TABLES
# 	select XTENSA_SMALL_VECTOR_TABLE_ENTRY
# 	select HAS_MCUX if CLOCK_CONTROL
# 	select HAS_MCUX_CCM if CLOCK_CONTROL
# 	select HAS_MCUX_IOMUXC if PINCTRL
# 	select PINCTRL_IMX if HAS_MCUX_IOMUXC
# 	select CPU_HAS_DCACHE

config SOC_SKYP_TXE
	select XTENSA
	select XTENSA_HAL
	select ARCH_SUPPORTS_COREDUMP
	select XTENSA_RESET_VECTOR
	select XTENSA_USE_CORE_CRT1
	select ATOMIC_OPERATIONS_BUILTIN
	select XTENSA_TENSILICA_NX
	select XTENSA_SMALL_VECTOR_TABLE_ENTRY
#	select ARCH_HAS_USERSPACE
	select CPU_HAS_DCACHE
	select CPU_HAS_MPU
	select XTENSA_MPU
	select ARCH_HAS_SINGLE_THREAD_SUPPORT
#        select DYNAMIC_OBJECTS 

# config MCUX_CORE_SUFFIX
# 	default "_dsp" if SOC_SKYP_TXE		
```

## soc/tsi/skyp_v1/Kconfig.defconfig
```kconfig
# Copyright (c) 2024 Renesas Electronics Corporation
# SPDX-License-Identifier: Apache-2.0

#if SOC_SERIES_SKYP_V1
if SOC_SKYP_M85

config SYS_CLOCK_HW_CYCLES_PER_SEC
	default 25000000

config NUM_IRQS
	default 128

endif # SOC_SERIES_SKYP_V1

if SOC_SKYP_TXE

config SYS_CLOCK_HW_CYCLES_PER_SEC
        default 200000000

config SYS_CLOCK_TICKS_PER_SEC
        default 50000

config XTENSA_TIMER
        default y

config KERNEL_ENTRY
        default "__start"

config PRIVILEGED_STACK_SIZE
	default 2048
endif
```

## soc/tsi/skyp_v1/Kconfig.soc
```kconfig
# Copyright (c) 2024 Renesas Electronics Corporation
# SPDX-License-Identifier: Apache-2.0


config SOC_SERIES_SKYP_V1
	bool
	select SOC_FAMILY_ARM
	help
	  Enable support for ARM MPS3 MCU Series

config SOC_SKYP
	bool
	select SOC_SERIES_SKYP_V1
	help
	  skyp

config SOC_SKYP_M85
	bool
	select SOC_SKYP
	help
	  skyp_m85

config XTENSA_TENSILICA_NX
        bool
        default y if SOC_SKYP_TXE
        help
          skyp_txe

config XCHAL_HAVE_XEA3
        bool
        default y if SOC_SKYP_TXE
        help
          skyp_txe		  


config SOC_SKYP_TXE
	bool
	select SOC_SKYP
	help
	  skyp_txe

config SOC_TOOLCHAIN_NAME
	string
	default "TENcore_nx_v02b_tie" if SOC_SKYP_TXE

config SOC_SERIES
	default "skyp_v1" if SOC_SERIES_SKYP_V1

config SOC
    default "skyp" if SOC_SKYP
    
```
