/*
 * Copyright 2021, 2023, 2024 NXP
 *
 * SPDX-License-Identifier: Apache-2.0
 */

/dts-v1/;

// #include <nxp/nxp_imx8m.dtsi>
// #include <nxp/nxp_imx/mimx8ml8dvnlz-pinctrl.dtsi>

// / {
// 	model = "NXP i.MX 8MPLUS Audio DSP";
// 	compatible = "nxp";

// 	chosen {
// 		//zephyr,sram = &sram0;
// 		zephyr,sram = &sram_txe;

// 		zephyr,console = &uart4;
// 		zephyr,shell-uart = &uart4;
// 	};
// 	sram_txe: memory@60040000 {
// 		device_type = "memory";
// 		compatible = "mmio-sram";
// 		reg = <0x60040000 DT_SIZE_K(512)>;
// 	};
// };

#include "sample_controller.dtsi"
#include <mem.h>

/ {
	model = "xt-sim";
	compatible = "cdns,xtensa-sample-controller";

	chosen {
		// zephyr,sram = &sram0;
		zephyr,sram = &sram_txe;
		// zephyr,console = &uart4;
		// zephyr,shell-uart = &uart4;
	};
	sram_txe: memory@60040000 {
		device_type = "memory";
		compatible = "mmio-sram";
		reg = <0x60040000 DT_SIZE_K(512)>;
		//reg = <0x60040000 0x80000>; // 512 * 1024 = 524288 (0x80000 in hex)
	};
};

&cpu0 {
	clock-frequency = <10000000>;
};