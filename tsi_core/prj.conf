## CMakeLists.txt
```
# SPDX-License-Identifier: Apache-2.0

cmake_minimum_required(VERSION 3.20.0)

# NS SRAM slot (TSI_NONSECURE_BASE); avoids collision with BL1_2 @ 0x60000000 in guest_mem.
set(DTC_OVERLAY_FILE ${CMAKE_CURRENT_SOURCE_DIR}/boards/gmc_ns_mem.overlay)

find_package(Zephyr REQUIRED HINTS $ENV{ZEPHYR_BASE})
project(m85)

target_sources(app PRIVATE
  src/main.c
  src/tsi_mailbox.c
)
```

## sample.yaml
```
sample:
  description: TSI Core platform - M85
  name: m85
common:
  tags: introduction
  integration_platforms:
    - tsi/skylp/m85
  harness: console
  harness_config:
    type: one_line
    regex:
      - "Tsavorite Scalable Intelligence"
      - [00:00:00.016 000] <inf> m85: Test Platform: tsi/skylp/m85
      - [00:00:00.018 000] <wrn> m85: Testing on FPGA
      - TSI Logging enabled and printk is functional
      - TSI Shell
tests:
  sample.m85:
    tags: introduction
```

## prj.conf
```kconfig
CONFIG_LOG=y
CONFIG_CONSOLE=y
CONFIG_LOG_PRINTK=y
CONFIG_UART_CONSOLE=y
CONFIG_SHELL=y
CONFIG_BOOT_BANNER=y
CONFIG_SHELL_BACKEND_SERIAL_INTERRUPT_DRIVEN=n
CONFIG_SHELL_BACKEND_SERIAL_RX_POLL_PERIOD=1

CONFIG_LOG_BACKEND_UART=y
#

# Use immediate mode so all messages are being
# printed. Under deferred mode, there may be
# dropped messages as there are quite a number of
# messages to be printed.
CONFIG_LOG_MODE_IMMEDIATE=y

# Need bigger stack for immediate mode
CONFIG_MAIN_STACK_SIZE=4096

# Set y on silicon with MPC; n on dual-QEMU lab (secure SRAM probes are informational).
# CONFIG_TSI_EXPECT_SECURE_ISOLATION=y
```

## boards/gmc_ns_mem.overlay
```dts
/*
 * GMC Zephyr memory map for dual-QEMU (shared guest_mem @ 0x60000000, 4 MiB).
 *
 * Link at TSI_NONSECURE_BASE (0x60100000) per architecture wiki. Mailbox SHM
 * at 0x6014F000 (last 4 KiB of the 320 KiB NS slot).
 */

&sram0 {
	reg = <0x60100000 DT_SIZE_K(128)>;
};

/* NS code + data through end of NS slot (0x60150000); SHM at 0x6014F000. */
&sram {
	reg = <0x60120000 0x00030000>;
};
```

## src/main.c
```c
/*
 * Copyright (c) 2024-2025 TSI
 *
 */

#include <stddef.h>
#include <stdio.h>
#include <zephyr/kernel.h>
#include <zephyr/version.h>
#include <zephyr/logging/log.h>
#include <zephyr/sys/printk.h>
#include <zephyr/logging/log_ctrl.h>
#include <zephyr/logging/log_output.h>
#include "tsi_mailbox.h"

#define LOG_MODULE_NAME plat_boot
LOG_MODULE_REGISTER(LOG_MODULE_NAME);
#define PRINT_TSI_BOOT_BANNER() printk("        Tsavorite Scalable Intelligence \n")

int main(void)
{
	int ret;

	/* TSI banner */
	PRINT_TSI_BOOT_BANNER();
	printf("\n");
	printf("    |||||||||||||||||||||||||||||||||||||\n");
	printf("    |||||||||||||||||||||||||||||||||||||\n");
	printf("    ||||||                          |||||\n");
	printf("    ||||||                          |||||\n");
	printf("    |||||||||||||||||   |||||       |||||\n");
	printf("               ||||||   |||||\n");
	printf("    ||||||     ||||||   |||||      ||||||\n");
	printf("     ||||||||  ||||||   |||||   ||||||||\n");
	printf("       ||||||||||||||   ||||||||||||||\n");
	printf("          |||||||||||   ||||||||||||\n");
	printf("            |||||||||   ||||||||||\n");
	printf("              |||||||   ||||||||\n");
	printf("                |||||   |||||\n");
	printf("                  |||   |||\n");
	printf("                        |\n");
	LOG_WRN("TSI Platform Software ");
	LOG_INF("Zephyr OS");
	printk("Zephyr Kernel version: %s\n", KERNEL_VERSION_STRING);
	printk("TSI Logging enabled & printk is functional\n");
	printk("Vtiwari custom GMC zephyr, with mailbox support: C1 \n");
	printk("[GMC-MB] main: starting mailbox handshake\n");
	tsi_mailbox_log_transport();

	ret = tsi_mailbox_boot_handshake(0U);
	if (ret != 0) {
		printk("[GMC-MB] main: handshake failed ret=%d\n", ret);
		LOG_ERR("Mailbox handshake failed: %d", ret);
		return ret;
	}
	printk("[GMC-MB] main: handshake done spe_ready=%d doorbell=0x%08x\n",
	       tsi_mailbox_spe_ready_seen() ? 1 : 0,
	       tsi_mailbox_read_doorbell());

	LOG_INF("Mailbox ready: spe_ready=%d doorbell=0x%08x",
		tsi_mailbox_spe_ready_seen() ? 1 : 0,
		tsi_mailbox_read_doorbell());

	ret = tsi_mailbox_run_psa_lab_sequence();
	if (ret != 0) {
		printk("[GMC-MB] main: PSA lab sequence failed ret=%d\n", ret);
		LOG_ERR("PSA lab sequence failed: %d", ret);
		return ret;
	}

	LOG_INF("PSA lab sequence OK (probe + VERSION + CONNECT + CALL over SHM)");
	return 0;
}
```

## src/tsi_isolation_test.c
```c
/*
 * Copyright (c) 2026 Tsavorite Scalable Intelligence, Inc.
 * SPDX-License-Identifier: Apache-2.0
 *
 * @file tsi_isolation_test.c
 * @brief GMC (Zephyr) probes for SMC SAU/MPU isolation — see BOOKMARK_SRAM_MPU_SAU.md.
 */

#include "tsi_isolation_test.h"
#include "tsi_mailbox.h"
#include <stdint.h>
#include <zephyr/sys/printk.h>

#define TSI_PROBE_TFM_S_BASE  0x600D0000u
#define TSI_PROBE_BL2_BASE    0x60050000u
#define TSI_PROBE_NS_OWN_BASE 0x60100000u

volatile uint32_t tsi_iso_fault_caught;

static int tsi_iso_probe_read(uint32_t addr, uint32_t *out, bool expect_fault)
{
	volatile uint32_t *p = (volatile uint32_t *)(uintptr_t)addr;
	uint32_t val;

	tsi_iso_fault_caught = 0;
	val = *p;

	if (expect_fault) {
		printk("[GMC-ISO] FAIL probe 0x%08x: read 0x%08x (expected fault on silicon)\n", addr,
		       val);
		return -1;
	}

	if (out != NULL) {
		*out = val;
	}
	printk("[GMC-ISO] PASS probe 0x%08x: read 0x%08x\n", addr, val);
	return 0;
}

int tsi_isolation_run_tests(bool expect_secure_isolation)
{
	int ret = 0;
	uint32_t dummy;

	printk("[GMC-ISO] expect_secure_isolation=%d\n", expect_secure_isolation ? 1 : 0);

	if (tsi_iso_probe_read(TSI_PROBE_NS_OWN_BASE, &dummy, false) != 0) {
		ret = -1;
	}

	if (tsi_iso_probe_read(TSI_MB_SHM_BASE, &dummy, false) != 0) {
		ret = -1;
	}

	if (expect_secure_isolation) {
		if (tsi_iso_probe_read(TSI_PROBE_TFM_S_BASE, &dummy, true) != 0) {
			ret = -1;
		}
		if (tsi_iso_probe_read(TSI_PROBE_BL2_BASE, &dummy, true) != 0) {
			ret = -1;
		}
	} else {
		(void)tsi_iso_probe_read(TSI_PROBE_TFM_S_BASE, &dummy, false);
		(void)tsi_iso_probe_read(TSI_PROBE_BL2_BASE, &dummy, false);
		printk("[GMC-ISO] lab mode: secure probes informational only (MPC may be absent)\n");
	}

	return ret;
}
```

## src/tsi_isolation_test.h
```c
#ifndef TSI_ISOLATION_TEST_H_
#define TSI_ISOLATION_TEST_H_

#include <stdbool.h>
#include <stdint.h>

extern volatile uint32_t tsi_iso_fault_caught;

int tsi_isolation_run_tests(bool expect_secure_isolation);

#endif /* TSI_ISOLATION_TEST_H_ */
```

## src/tsi_mailbox.c
```c
#include "tsi_mailbox.h"

#include <zephyr/kernel.h>
#include <zephyr/logging/log.h>
#include <zephyr/sys/barrier.h>
#include <zephyr/sys/printk.h>
#include <zephyr/sys/sys_io.h>

LOG_MODULE_DECLARE(plat_boot, LOG_LEVEL_INF);

/* SMC programs init.slot_count in tfm_mailbox_hal_init() (ns_agent_mailbox). */
#define TSI_MB_SMC_INIT_TIMEOUT_MS  120000U
#define TSI_MB_SPE_READY_TIMEOUT_MS   60000U

static volatile struct tsi_mb_shm *const mb_shm =
	(volatile struct tsi_mb_shm *)(uintptr_t)TSI_MB_SHM_BASE;

void tsi_mailbox_log_transport(void)
{
	printk("[GMC-MB] transport: data=MAILBOX_SHM @0x%08x "
	       "(pend/replied/slots); ctrl=SCU mailbox10 @0x%08x "
	       "(doorbell, local per QEMU instance)\n",
	       TSI_MB_SHM_BASE, TSI_SCU_MAILBOX10_REG);
	printk("[GMC-MB] transport: doorbell words NS_INIT=0x%08x SPE_READY=0x%08x "
	       "PSA_REQ=0x%08x PSA_REPLY=0x%08x\n",
	       TSI_MB_DOORBELL_NS_INIT, TSI_MB_DOORBELL_SPE_READY,
	       TSI_MB_DOORBELL_PSA_REQ, TSI_MB_DOORBELL_PSA_REPLY);
	printk("[GMC-MB] transport: lab probe sid=0x%08x expect_reply=0x%08x\n",
	       TSI_MB_PSA_PROBE_SID, TSI_MB_PSA_PROBE_REPLY_MAGIC);
	printk("[GMC-MB] transport: platform sid=0x%08x handle=%u ioctl iobuf@0x%08x\n",
	       TSI_MB_PLATFORM_SERVICE_SID, TSI_MB_PLATFORM_STATELESS_HANDLE,
	       TSI_MB_IOBUF_BASE);
}

static void tsi_mailbox_log_enqueue_meta(uint8_t slot_idx, const struct tsi_mb_msg *msg)
{
	uint32_t detail = 0U;

	switch (msg->call_type) {
	case TSI_MB_MAILBOX_PSA_VERSION:
		detail = msg->params.psa_version_params.sid;
		break;
	case TSI_MB_MAILBOX_PSA_CONNECT:
		detail = msg->params.psa_connect_params.sid;
		break;
	case TSI_MB_MAILBOX_PSA_CALL:
		detail = (uint32_t)msg->params.psa_call_params.type;
		break;
	default:
		break;
	}

	printk("[GMC-MB] enqueue: slot=%u psa_type=0x%x client=%d detail=0x%08x "
	       "pend=0x%08x replied=0x%08x shm@0x%08x doorbell10=0x%08x (PSA_REQ=0x%08x)\n",
	       slot_idx, msg->call_type, msg->client_id, detail,
	       mb_shm->status.pend_slots, mb_shm->status.replied_slots,
	       TSI_MB_SHM_BASE, tsi_mailbox_read_doorbell(), TSI_MB_DOORBELL_PSA_REQ);
}

static inline void tsi_mb_doorbell_write(uint32_t value)
{
	sys_write32(value, TSI_SCU_MAILBOX10_REG);
}

uint32_t tsi_mailbox_read_doorbell(void)
{
	return sys_read32(TSI_SCU_MAILBOX10_REG);
}

uint32_t tsi_mailbox_read_pend_mask(void)
{
	return mb_shm->status.pend_slots;
}

uint32_t tsi_mailbox_read_replied_mask(void)
{
	return mb_shm->status.replied_slots;
}

bool tsi_mailbox_spe_ready_seen(void)
{
	return (mb_shm->spe_peer_ready == TSI_MB_SPE_PEER_READY_MAGIC);
}

static bool tsi_mailbox_smc_mailbox_initialized(void)
{
	/*
	 * Require init.status and slot_count from the current SMC reset only.
	 * Stale slot_count in guest_mem (previous run) must not pass this check:
	 * GMC could write ns_peer_ready, then SMC memset clears it, and SMC
	 * later times out (BOOT_STATUS 0xB4) while GMC waits for spe_ready.
	 */
	return (mb_shm->init.slot_count != 0U &&
		(uintptr_t)mb_shm->init.status == (uintptr_t)&mb_shm->status);
}

int tsi_mailbox_boot_handshake(uint32_t timeout_ms)
{
	uint32_t waited_ms = 0U;
	uint32_t spe_wait_ms = 0U;

	(void)timeout_ms;

	/*
	 * GMC may run long before tfm_s: wait for SMC mailbox HAL (init.slot_count).
	 * Doorbell NS_INIT is not reliable on dual-QEMU (mailbox10 is per instance).
	 */
	printk("[GMC-MB] handshake: waiting for SMC mailbox init (timeout=%u ms)\n",
	       TSI_MB_SMC_INIT_TIMEOUT_MS);
	while (waited_ms < TSI_MB_SMC_INIT_TIMEOUT_MS) {
		if (tsi_mailbox_smc_mailbox_initialized()) {
			break;
		}
		if ((waited_ms % 10000U) == 0U && waited_ms > 0U) {
			printk("[GMC-MB] handshake: still waiting SMC init (%u ms) "
			       "slot_count=%u init.status=0x%08x spe_ready=0x%08x\n",
			       waited_ms, mb_shm->init.slot_count,
			       (uint32_t)(uintptr_t)mb_shm->init.status,
			       mb_shm->spe_peer_ready);
		}
		k_msleep(10);
		waited_ms += 10U;
	}

	if (!tsi_mailbox_smc_mailbox_initialized()) {
		const uintptr_t off_slot_count =
			(uintptr_t)&mb_shm->init.slot_count - TSI_MB_SHM_BASE;

		printk("[GMC-MB] handshake: SMC init timeout slot_count=%u "
		       "init.status=0x%08x (SHM @ 0x%08x; guest_mem xxd -s 0x%zx)\n",
		       mb_shm->init.slot_count,
		       (uint32_t)(uintptr_t)mb_shm->init.status,
		       TSI_MB_SHM_BASE, off_slot_count);
		return TSI_MB_TIMEOUT;
	}

	printk("[GMC-MB] handshake: SMC init ok slot_count=%u (waited=%u ms)\n",
	       mb_shm->init.slot_count, waited_ms);

	/*
	 * guest_mem may retain spe_ready from a previous QEMU run while tfm_s is
	 * still booting and not polling SHM. Wait for SMC tsi_mailbox_shm_reset()
	 * to clear spe_ready before we publish ns_peer_ready.
	 */
	if (mb_shm->spe_peer_ready != 0U) {
		printk("[GMC-MB] handshake: stale spe_ready=0x%08x; waiting for SMC reset\n",
		       mb_shm->spe_peer_ready);
		waited_ms = 0U;
		while (waited_ms < TSI_MB_SMC_INIT_TIMEOUT_MS) {
			if (mb_shm->spe_peer_ready == 0U) {
				printk("[GMC-MB] handshake: SMC shm reset seen (spe_ready=0)\n");
				break;
			}
			k_msleep(10);
			waited_ms += 10U;
		}
		if (mb_shm->spe_peer_ready != 0U) {
			printk("[GMC-MB] handshake: spe_ready never cleared (still 0x%08x)\n",
			       mb_shm->spe_peer_ready);
		}
	}

	mb_shm->ns_peer_ready = TSI_MB_NS_PEER_READY_MAGIC;
	barrier_dmem_fence_full();

	printk("[GMC-MB] handshake: waiting for spe_ready (timeout=%u ms)\n",
	       TSI_MB_SPE_READY_TIMEOUT_MS);
	while (spe_wait_ms < TSI_MB_SPE_READY_TIMEOUT_MS) {
		if (tsi_mailbox_spe_ready_seen()) {
			break;
		}
		/*
		 * Re-publish ns_peer_ready: SMC tsi_mailbox_shm_reset() may run after
		 * we first wrote it (stale slot_count race or late tfm_s init).
		 */
		mb_shm->ns_peer_ready = TSI_MB_NS_PEER_READY_MAGIC;
		barrier_dmem_fence_full();
		k_msleep(10);
		spe_wait_ms += 10U;
	}

	if (!tsi_mailbox_spe_ready_seen()) {
		/*
		 * Dual-QEMU: SMC may set spe_ready only after a late poll in
		 * ns_agent_mailbox. If ns_peer_ready is set, continue for lab tests.
		 */
		if (mb_shm->ns_peer_ready == TSI_MB_NS_PEER_READY_MAGIC) {
			printk("[GMC-MB] handshake: spe_ready timeout (0x%08x); "
			       "continuing with ns_ready for dual-QEMU lab\n",
			       mb_shm->spe_peer_ready);
			return TSI_MB_SUCCESS;
		}
		printk("[GMC-MB] handshake: spe_ready timeout spe_ready=0x%08x\n",
		       mb_shm->spe_peer_ready);
		return TSI_MB_TIMEOUT;
	}

	printk("[GMC-MB] handshake: ns_ready=0x%08x spe_ready=0x%08x doorbell=0x%08x (shm)\n",
	       mb_shm->ns_peer_ready, mb_shm->spe_peer_ready,
	       tsi_mailbox_read_doorbell());

	/* Allow SMC ns_agent_mailbox to enter the SHM poll loop before PSA traffic. */
	k_msleep(500);

	return TSI_MB_SUCCESS;
}

int tsi_mailbox_enqueue_psa_version(uint8_t slot_idx, uint32_t sid, int32_t client_id)
{
	struct tsi_mb_msg msg = { 0 };

	msg.call_type = TSI_MB_MAILBOX_PSA_VERSION;
	msg.client_id = client_id;
	msg.params.psa_version_params.sid = sid;

	return tsi_mailbox_enqueue_raw(slot_idx, &msg);
}

int tsi_mailbox_enqueue_psa_connect(uint8_t slot_idx, uint32_t sid, uint32_t version,
				    int32_t client_id)
{
	struct tsi_mb_msg msg = { 0 };

	msg.call_type = TSI_MB_MAILBOX_PSA_CONNECT;
	msg.client_id = client_id;
	msg.params.psa_connect_params.sid = sid;
	msg.params.psa_connect_params.version = version;

	return tsi_mailbox_enqueue_raw(slot_idx, &msg);
}

int tsi_mailbox_enqueue_psa_call(uint8_t slot_idx, int32_t handle, int32_t type,
				 const struct tsi_mb_iovec *in_vec, uint32_t in_len,
				 const struct tsi_mb_iovec *out_vec, uint32_t out_len,
				 int32_t client_id)
{
	struct tsi_mb_msg msg = { 0 };

	if ((in_len > 0U && in_vec == NULL) || (out_len > 0U && out_vec == NULL)) {
		return TSI_MB_INVAL_PARAMS;
	}

	msg.call_type = TSI_MB_MAILBOX_PSA_CALL;
	msg.client_id = client_id;
	msg.params.psa_call_params.handle = handle;
	msg.params.psa_call_params.type = type;
	msg.params.psa_call_params.in_vec = (uint32_t)(uintptr_t)in_vec;
	msg.params.psa_call_params.in_len = in_len;
	msg.params.psa_call_params.out_vec = (uint32_t)(uintptr_t)out_vec;
	msg.params.psa_call_params.out_len = out_len;

	return tsi_mailbox_enqueue_raw(slot_idx, &msg);
}

int tsi_mailbox_enqueue_psa_close(uint8_t slot_idx, int32_t handle, int32_t client_id)
{
	struct tsi_mb_msg msg = { 0 };

	msg.call_type = TSI_MB_MAILBOX_PSA_CLOSE;
	msg.client_id = client_id;
	msg.params.psa_close_params.handle = handle;

	return tsi_mailbox_enqueue_raw(slot_idx, &msg);
}

int tsi_mailbox_transact(uint8_t slot_idx, const struct tsi_mb_msg *msg, int32_t *reply,
			 uint32_t timeout_ms)
{
	int ret;

	ret = tsi_mailbox_enqueue_raw(slot_idx, msg);
	if (ret != TSI_MB_SUCCESS) {
		return ret;
	}

	return tsi_mailbox_wait_reply(slot_idx, reply, timeout_ms);
}

int tsi_mailbox_enqueue_raw(uint8_t slot_idx, const struct tsi_mb_msg *msg)
{
	volatile struct tsi_mb_slot *slot;
	uint32_t slot_bit;

	if (slot_idx >= TSI_MB_SLOT_COUNT || msg == NULL) {
		return TSI_MB_INVAL_PARAMS;
	}

	slot = &mb_shm->slots[slot_idx];
	slot_bit = BIT(slot_idx);

	slot->msg = *msg;
	slot->reply.return_val = 0;

	barrier_dmem_fence_full();
	mb_shm->status.replied_slots &= ~slot_bit;
	mb_shm->status.pend_slots |= slot_bit;
	barrier_dmem_fence_full();

	tsi_mb_doorbell_write(TSI_MB_DOORBELL_PSA_REQ);
	tsi_mailbox_log_enqueue_meta(slot_idx, msg);
	return TSI_MB_SUCCESS;
}

static void tsi_mailbox_iobuf_setup_platform_ioctl(void)
{
	volatile struct tsi_mb_iobuf *io = TSI_MB_IOBUF;

	io->ioctl_request = (int32_t)TSI_MB_PLATFORM_IOCTL_PROBE_REQ;
	io->ioctl_reply = 0U;
	io->in_vec[0].base = (uintptr_t)&io->ioctl_request;
	io->in_vec[0].len = sizeof(io->ioctl_request);
	io->out_vec[0].base = (uintptr_t)&io->ioctl_reply;
	io->out_vec[0].len = sizeof(io->ioctl_reply);
	barrier_dmem_fence_full();
}

int tsi_mailbox_run_psa_lab_sequence(void)
{
	int32_t reply = 0;
	int ret;
	const int32_t client_id = -1;
	const uint8_t slot = 0U;
	const uint32_t timeout_ms = 5000U;

	/*
	 * Re-publish ns_peer_ready and give SMC a few poll iterations to leave
	 * boot-time handshake loops before the first PSA request.
	 */
	mb_shm->ns_peer_ready = TSI_MB_NS_PEER_READY_MAGIC;
	barrier_dmem_fence_full();

	/* 1) SHM transport probe (platform fast-path on SMC). */
	printk("[GMC-MB] psa-lab: [1/4] PSA_VERSION probe sid=0x%08x\n", TSI_MB_PSA_PROBE_SID);
	ret = tsi_mailbox_enqueue_psa_version(slot, TSI_MB_PSA_PROBE_SID, client_id);
	if (ret == TSI_MB_SUCCESS) {
		ret = tsi_mailbox_wait_reply(slot, &reply, timeout_ms);
	}
	if (ret != TSI_MB_SUCCESS || reply != (int32_t)TSI_MB_PSA_PROBE_REPLY_MAGIC) {
		printk("[GMC-MB] psa-lab: probe failed ret=%d reply=0x%08x "
		       "(repackage tfm_s; SMC BOOT_STATUS expect 0xB6)\n",
		       ret, (uint32_t)reply);
		return (ret != TSI_MB_SUCCESS) ? ret : TSI_MB_INVAL_PARAMS;
	}
	printk("[GMC-MB] psa-lab: probe OK reply=0x%08x\n", (uint32_t)reply);

	/* 2) PSA_VERSION on TFM platform service (real SID). */
	printk("[GMC-MB] psa-lab: [2/4] PSA_VERSION platform sid=0x%08x\n",
	       TSI_MB_PLATFORM_SERVICE_SID);
	ret = tsi_mailbox_enqueue_psa_version(slot, TSI_MB_PLATFORM_SERVICE_SID, client_id);
	if (ret == TSI_MB_SUCCESS) {
		ret = tsi_mailbox_wait_reply(slot, &reply, timeout_ms);
	}
	if (ret != TSI_MB_SUCCESS) {
		printk("[GMC-MB] psa-lab: PSA_VERSION failed ret=%d\n", ret);
		return ret;
	}
	if (reply == (int32_t)TSI_MB_PLATFORM_VERSION_EXPECTED) {
		printk("[GMC-MB] psa-lab: PSA_VERSION OK reply=0x%08x (platform SP present)\n",
		       (uint32_t)reply);
	} else if (reply == 0) {
		printk("[GMC-MB] psa-lab: PSA_VERSION reply=0 (PSA_VERSION_NONE; "
		       "platform SP may be absent — continuing)\n");
	} else {
		printk("[GMC-MB] psa-lab: PSA_VERSION reply=0x%08x (expected 0 or 0x%08x)\n",
		       (uint32_t)reply, (uint32_t)TSI_MB_PLATFORM_VERSION_EXPECTED);
	}

	/*
	 * 3) PSA_CONNECT on stateless platform (TF-M: PSA_ERROR_PROGRAMMER_ERROR).
	 */
	printk("[GMC-MB] psa-lab: [3/4] PSA_CONNECT platform sid=0x%08x (stateless -> error)\n",
	       TSI_MB_PLATFORM_SERVICE_SID);
	ret = tsi_mailbox_enqueue_psa_connect(slot, TSI_MB_PLATFORM_SERVICE_SID,
					      TSI_MB_PLATFORM_SERVICE_VERSION, client_id);
	if (ret == TSI_MB_SUCCESS) {
		ret = tsi_mailbox_wait_reply(slot, &reply, timeout_ms);
	}
	if (ret != TSI_MB_SUCCESS) {
		printk("[GMC-MB] psa-lab: PSA_CONNECT transact failed ret=%d\n", ret);
		return ret;
	}
	if (reply != TSI_MB_PSA_ERROR_PROGRAMMER_ERROR &&
	    reply != TSI_MB_PSA_ERROR_CONNECTION_REFUSED) {
		printk("[GMC-MB] psa-lab: PSA_CONNECT unexpected reply=0x%08x "
		       "(expect 0x%08x PROGRAMMER_ERROR or 0x%08x CONNECTION_REFUSED)\n",
		       (uint32_t)reply, (uint32_t)TSI_MB_PSA_ERROR_PROGRAMMER_ERROR,
		       (uint32_t)TSI_MB_PSA_ERROR_CONNECTION_REFUSED);
		return TSI_MB_INVAL_PARAMS;
	}
	printk("[GMC-MB] psa-lab: PSA_CONNECT OK reply=0x%08x (stateless reject)\n",
	       (uint32_t)reply);

	/* 4) PSA_CALL platform IOCTL with in/out vectors in shared IOBUF. */
	{
		volatile struct tsi_mb_iobuf *io = TSI_MB_IOBUF;

		tsi_mailbox_iobuf_setup_platform_ioctl();
		printk("[GMC-MB] psa-lab: [4/4] PSA_CALL handle=%u type=IOCTL(%d) iobuf@0x%08x\n",
		       TSI_MB_PLATFORM_STATELESS_HANDLE, TSI_MB_PLATFORM_API_ID_IOCTL,
		       TSI_MB_IOBUF_BASE);
		ret = tsi_mailbox_enqueue_psa_call(slot, TSI_MB_PLATFORM_STATELESS_HANDLE,
						   TSI_MB_PLATFORM_API_ID_IOCTL,
						   io->in_vec, 1U, io->out_vec, 1U, client_id);
	}
	if (ret == TSI_MB_SUCCESS) {
		ret = tsi_mailbox_wait_reply(slot, &reply, timeout_ms);
	}
	if (ret != TSI_MB_SUCCESS) {
		printk("[GMC-MB] psa-lab: PSA_CALL failed ret=%d\n", ret);
		return ret;
	}
	printk("[GMC-MB] psa-lab: PSA_CALL status=0x%08x ioctl_reply=0x%08x (expect 0x%08x)\n",
	       (uint32_t)reply, TSI_MB_IOBUF->ioctl_reply, TSI_MB_PLATFORM_IOCTL_REPLY_MAGIC);

	if (reply != 0 || TSI_MB_IOBUF->ioctl_reply != TSI_MB_PLATFORM_IOCTL_REPLY_MAGIC) {
		return TSI_MB_INVAL_PARAMS;
	}

	printk("[GMC-MB] psa-lab: sequence complete (SHM pend/replied + PSA VERSION/CONNECT/CALL)\n");
	return TSI_MB_SUCCESS;
}

int tsi_mailbox_wait_reply(uint8_t slot_idx, int32_t *return_val, uint32_t timeout_ms)
{
	uint32_t waited_ms = 0U;
	uint32_t slot_bit;

	if (slot_idx >= TSI_MB_SLOT_COUNT || return_val == NULL) {
		return TSI_MB_INVAL_PARAMS;
	}

	slot_bit = BIT(slot_idx);

	while (waited_ms < timeout_ms) {
		uint32_t replied = mb_shm->status.replied_slots;

		if ((replied & slot_bit) != 0U) {
			*return_val = mb_shm->slots[slot_idx].reply.return_val;
			printk("[GMC-MB] wait: reply slot=%u return_val=0x%08x (%d) waited=%u ms "
			       "pend=0x%08x replied=0x%08x shm@0x%08x doorbell10=0x%08x\n",
			       slot_idx, (uint32_t)*return_val, *return_val, waited_ms,
			       mb_shm->status.pend_slots, mb_shm->status.replied_slots,
			       TSI_MB_SHM_BASE, tsi_mailbox_read_doorbell());
			if (*return_val == (int32_t)TSI_MB_PSA_PROBE_REPLY_MAGIC) {
				printk("[GMC-MB] wait: probe reply magic OK (0x%08x)\n",
				       TSI_MB_PSA_PROBE_REPLY_MAGIC);
			} else if (mb_shm->slots[slot_idx].msg.call_type ==
				   TSI_MB_MAILBOX_PSA_VERSION &&
				   mb_shm->slots[slot_idx].msg.params.psa_version_params.sid ==
					   TSI_MB_PSA_PROBE_SID) {
				printk("[GMC-MB] wait: probe reply MISMATCH expect=0x%08x got=0x%08x\n",
				       TSI_MB_PSA_PROBE_REPLY_MAGIC, (uint32_t)*return_val);
			}
			return TSI_MB_SUCCESS;
		}

		if ((waited_ms % 500U) == 0U) {
			printk("[GMC-MB] wait: pending slot=%u waited=%u ms pend=0x%08x replied=0x%08x doorbell=0x%08x\n",
			       slot_idx, waited_ms,
			       mb_shm->status.pend_slots, mb_shm->status.replied_slots,
			       tsi_mailbox_read_doorbell());
		}

		k_msleep(1);
		waited_ms++;
	}

	printk("[GMC-MB] wait: timeout slot=%u timeout_ms=%u pend=0x%08x replied=0x%08x doorbell=0x%08x\n",
	       slot_idx, timeout_ms,
	       mb_shm->status.pend_slots, mb_shm->status.replied_slots,
	       tsi_mailbox_read_doorbell());
	return TSI_MB_TIMEOUT;
}
```

## src/tsi_mailbox.h
```c
#ifndef TSI_CORE_MAILBOX_H_
#define TSI_CORE_MAILBOX_H_

#include <stdbool.h>
#include <stddef.h>
#include <stdint.h>

/* TF-M mailbox ABI constants used by SMC side. */
#define TSI_MB_MAILBOX_PSA_FRAMEWORK_VERSION 0x1u
#define TSI_MB_MAILBOX_PSA_VERSION           0x2u
#define TSI_MB_MAILBOX_PSA_CONNECT           0x3u
#define TSI_MB_MAILBOX_PSA_CALL              0x4u
#define TSI_MB_MAILBOX_PSA_CLOSE             0x5u

#define TSI_MB_SUCCESS      0
#define TSI_MB_INVAL_PARAMS (-2147483646) /* INT32_MIN + 2 */
#define TSI_MB_TIMEOUT      (-110)

/*
 * Must match SMC TF-M build (`NUM_MAILBOX_QUEUE_SLOT`).
 */
#ifndef TSI_MB_SLOT_COUNT
#define TSI_MB_SLOT_COUNT 4u
#endif

/*
 * Match TF-M when MAILBOX_IS_UNCACHED_S/NS == 1: MAILBOX_ALIGN is empty in
 * tfm_mailbox.h (no 32-byte padding). Do not add __aligned__(32) here.
 */
#define TSI_MB_ALIGN

/* SCU mailbox registers and doorbell words. */
#define TSI_SCU_MAILBOX10_REG 0x800001F8u

#define TSI_MB_DOORBELL_NS_INIT   0x000000AEu
#define TSI_MB_DOORBELL_SPE_READY 0x000000C3u
#define TSI_MB_DOORBELL_PSA_REQ   0xA5CF50C6u
#define TSI_MB_DOORBELL_PSA_REPLY 0xC605FC5Au

/* Lab probe SID / reply magic (must match SMC tsi_mailbox.h). */
#define TSI_MB_PSA_PROBE_SID           0x474D4302u /* 'GMC\x02' */
#define TSI_MB_PSA_PROBE_REPLY_MAGIC   0x50454101u /* 'PEA\x01' */

/* TFM platform partition (manifest stateless_handle 6 -> encoded PSA handle). */
#define TSI_MB_PLATFORM_SERVICE_SID        0x00000040u
#define TSI_MB_PLATFORM_SERVICE_VERSION    1u
#define TSI_MB_PLATFORM_STATELESS_HANDLE   0x40000105u
#define TSI_MB_PLATFORM_API_ID_IOCTL       1013

#define TSI_MB_PLATFORM_IOCTL_PROBE_REQ    0x54534901u /* 'TSI\x01' */
#define TSI_MB_PLATFORM_IOCTL_REPLY_MAGIC  0x504C4101u /* 'PLA\x01' */
/* TF-M tfm_spm_client_psa_version() returns service manifest version (see tfm_platform.yaml). */
#define TSI_MB_PLATFORM_VERSION_EXPECTED     TSI_MB_PLATFORM_SERVICE_VERSION
/* psa/error.h — stateless platform CONNECT lab (TF-M returns PROGRAMMER_ERROR) */
#define TSI_MB_PSA_ERROR_PROGRAMMER_ERROR      ((int32_t)-129)
#define TSI_MB_PSA_ERROR_CONNECTION_REFUSED    ((int32_t)-130)

/*
 * IO buffers for PSA_CALL in/out vectors (both M85 map this NS SRAM in guest_mem).
 * Must sit in GMC RAM and below MAILBOX_SHM (0x6014F000).
 */
#define TSI_MB_IOBUF_BASE 0x6014E000u

/* Shared mailbox window — last 4 KiB of 320 KiB NS slot (architecture wiki). */
#ifndef TSI_MB_SHM_BASE
#define TSI_MB_SHM_BASE 0x6014F000u
#endif

#define TSI_MB_NS_PEER_READY_MAGIC  0x474D4301u /* 'GMC\x01' */
#define TSI_MB_SPE_PEER_READY_MAGIC 0x53504501u /* 'SPE\x01' */

/* GDB / xxd helpers (packed layout, same as struct tsi_mailbox_shm_layout_t). */
#define TSI_MB_SHM_OFF_INIT_STATUS   0x98u
#define TSI_MB_SHM_OFF_SLOT_COUNT    0xa0u
#define TSI_MB_SHM_OFF_NS_PEER_READY 0xb0u
#define TSI_MB_SHM_OFF_SPE_PEER_READY 0xb4u

/* Same as struct psa_client_params_t in tfm_mailbox.h (32-bit). */
struct tsi_mb_psa_client_params {
	union {
		struct {
			uint32_t sid;
		} psa_version_params;
		struct {
			uint32_t sid;
			uint32_t version;
		} psa_connect_params;
		struct {
			int32_t handle;
			int32_t type;
			uint32_t in_vec;
			uint32_t in_len;
			uint32_t out_vec;
			uint32_t out_len;
		} psa_call_params;
		struct {
			int32_t handle;
		} psa_close_params;
	};
};

struct tsi_mb_msg {
	uint32_t call_type;
	struct tsi_mb_psa_client_params params;
	int32_t client_id;
} TSI_MB_ALIGN;

struct tsi_mb_reply {
	int32_t return_val;
} TSI_MB_ALIGN;

struct tsi_mb_slot {
	struct tsi_mb_msg msg;
	struct tsi_mb_reply reply;
} TSI_MB_ALIGN;

struct tsi_mb_status {
	uint32_t pend_slots;
	uint32_t replied_slots;
} TSI_MB_ALIGN;

struct tsi_mb_init {
	struct tsi_mb_status *status;
	uint32_t slot_count;
	struct tsi_mb_slot *slots;
};

/*
 * Must match struct tsi_mailbox_shm_layout_t in tsi_mailbox_shm.h (TF-M side).
 */
struct tsi_mb_shm {
	struct tsi_mb_status status;
	struct tsi_mb_slot slots[TSI_MB_SLOT_COUNT];
	struct tsi_mb_init init;
	uint32_t ns_peer_ready;
	uint32_t spe_peer_ready;
};

/* PSA in/out vector layout for mailbox PSA_CALL (uintptr_t + len). */
struct tsi_mb_iovec {
	uintptr_t base;
	uint32_t len;
};

struct tsi_mb_iobuf {
	int32_t ioctl_request;
	uint32_t ioctl_reply;
	struct tsi_mb_iovec in_vec[1];
	struct tsi_mb_iovec out_vec[1];
};

#define TSI_MB_IOBUF ((volatile struct tsi_mb_iobuf *)(uintptr_t)TSI_MB_IOBUF_BASE)

void tsi_mailbox_log_transport(void);

int tsi_mailbox_boot_handshake(uint32_t timeout_ms);
int tsi_mailbox_enqueue_raw(uint8_t slot_idx, const struct tsi_mb_msg *msg);
int tsi_mailbox_enqueue_psa_version(uint8_t slot_idx, uint32_t sid, int32_t client_id);
int tsi_mailbox_enqueue_psa_connect(uint8_t slot_idx, uint32_t sid, uint32_t version,
				    int32_t client_id);
int tsi_mailbox_enqueue_psa_call(uint8_t slot_idx, int32_t handle, int32_t type,
				 const struct tsi_mb_iovec *in_vec, uint32_t in_len,
				 const struct tsi_mb_iovec *out_vec, uint32_t out_len,
				 int32_t client_id);
int tsi_mailbox_enqueue_psa_close(uint8_t slot_idx, int32_t handle, int32_t client_id);
int tsi_mailbox_wait_reply(uint8_t slot_idx, int32_t *return_val, uint32_t timeout_ms);
int tsi_mailbox_transact(uint8_t slot_idx, const struct tsi_mb_msg *msg, int32_t *reply,
			 uint32_t timeout_ms);
int tsi_mailbox_run_psa_lab_sequence(void);

uint32_t tsi_mailbox_read_doorbell(void);
uint32_t tsi_mailbox_read_pend_mask(void);
uint32_t tsi_mailbox_read_replied_mask(void);
bool tsi_mailbox_spe_ready_seen(void);

#endif
```
