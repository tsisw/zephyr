## soc/tsi/skylp_v1/Kconfig
```kconfig
# Copyright (c) 2024 Renesas Electronics Corporation
# SPDX-License-Identifier: Apache-2.0

config SOC_SERIES_SKYLP_V1
	select ARM

config SOC_SERIES_SKYLP_V1
	select CPU_CORTEX_M85
	select CPU_HAS_ARM_SAU
	select CPU_HAS_ARM_MPU
	select CPU_HAS_FPU
	select ARMV8_M_DSP
	select ARMV8_1_M_MVEI
	select ARMV8_1_M_MVEF
	select ARMV8_1_M_PMU

config ARMV8_1_M_PMU_EVENTCNT
	int
	default 8 if SOC_SERIES_SKYLP_V1

config TSI_IONE_PADS_G0838
	bool "IONE UART pad map of the G0838 RAL release"
	depends on SOC_SERIES_SKYLP_V1
	help
	  The IONE pad-control block moved down by 4 between the G0822 and G0838
	  RAL releases. Select this for bitstreams built from G0838 (e.g. the
	  acboot_838 pro-FPGA compiles); leave it off for G0822 compiles. With the
	  wrong map the UART TX pads are set to input and RX_1 to output at boot.
```
