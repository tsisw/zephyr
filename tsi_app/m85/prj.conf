## sample.yaml
```
sample:
  description: TSI Core platform  application on M85
  name: m85
common:
  tags: introduction
  integration_platforms:
    - ek_tsi_skyp 
  harness: console
  harness_config:
    type: one_line
    regex:
      -!! ------------------------------------------ !!
      -!! WELCOME TO TSAVORITE SCALABLE INTELLIGENCE !!
      -!! ------------------------------------------ !!
      - [00:00:00.010,000] <inf> m85: Test Platform: ek_tsi/skyp/m85
      - [00:00:00.010,000] <wrn> m85: Testing on FPGA; Multi module init TBD 
tests:
  sample.m85:
    tags: apps  
```

## prj.conf
```kconfig
CONFIG_LOG=y
CONFIG_CONSOLE=y
CONFIG_LOG_PRINTK=y
CONFIG_UART_CONSOLE=y
CONFIG_SHELL=y
CONFIG_BOOT_BANNER=y
CONFIG_SHELL_BACKEND_SERIAL_INTERRUPT_DRIVEN=n
CONFIG_SHELL_BACKEND_SERIAL_RX_POLL_PERIOD=1
CONFIG_LOG_BACKEND_UART=y

# Use immediate mode so all messages are being
# printed. Under deferred mode, there may be
# dropped messages as there are quite a number of
# messages to be printed.
CONFIG_LOG_MODE_IMMEDIATE=y

# Need bigger stack for immediate mode
CONFIG_MAIN_STACK_SIZE=4096
```

## src/main.c
```c
/*
 * Copyright (c) 2012-2014 Wind River Systems, Inc.
 *
 * SPDX-License-Identifier: Apache-2.0
 */

#include <stddef.h>
#include <stdio.h>
#include <zephyr/kernel.h>
#include <zephyr/logging/log.h>
#include <zephyr/sys/printk.h>
#include <zephyr/logging/log_ctrl.h>
#include <zephyr/logging/log_output.h>

#define PRINT_TSI_BOOT_BANNER()  printk("***** !! WELCOME TO TSAVORITE SCALABLE INTELLIGENCE !! *****\n")
#define LOG_MODULE_NAME tsi_m85_
LOG_MODULE_REGISTER(LOG_MODULE_NAME);

int main(void)
{

	/* TSI banner */
	PRINT_TSI_BOOT_BANNER();
	LOG_INF("Test Platform: %s", CONFIG_BOARD_TARGET);

	LOG_WRN("Testing on FPGA; Multi module init TBD");
	LOG_DBG("Debugging - tsi_app module");

	return 0;
}
```
